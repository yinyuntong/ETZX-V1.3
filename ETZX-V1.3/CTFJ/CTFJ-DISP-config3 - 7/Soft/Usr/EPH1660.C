#define _IN_EPH1660
#include "CONFIG.H"


void Delayms(uint16 ms);
void ResetEPH1660(void);
uint8 GenerateCRC(uint8 * Packet,uint8 size);
void MasterSPIInitiEPH1660(void);
void MasterSPI_Send_Eph1660_Command(uint8 * Databuf,uint8 l);
void EPH1660Manager(void);



uint8 xdata Num;
uint8 xdata MCUSndDataLength,MCUSndDataPosition;	//数据长度,数据位置
xdata uint8 code *MCUSndDataBuff;	//数据指针
uint8 xdata SPIRecData;	//接收数据缓存

uint8 bdata flag;
sbit RecFramFinishFlag=flag^0;	//接收完一帧数据
sbit MCUSndFlag	=	flag^1;		//单片机发送标志
sbit MCUSndCmdFinishFlag	=	flag^2;	//一帧命令发送完成标志
sbit VerifyingFlag	=flag^3;	//正在计算校验和标志

//----------------------------------------------------------------------------------------------
uint8 code Recognition_Mode[8]={0x50,0x49,0x04,0x00,0xFF,0xFF,0xFF,0x06}; //设置汉字识别模式
uint8 code GraphicMode[8]=     {0x50,0x49,0x04,0x01,0xFF,0xFF,0xFF,0x10};	//设置为图片模式
//uint8   code   Set_Area[8]={0x50,0x46,0x04,0x30,0x5E,0xCE,0xD7,0x28};         //设置手写区域(90,100,390,230)
uint8 code Set_Area[8]={0x50,0x46,0x04,0x10,0x10,0xF0,0xF0,0x96};         

uint8 code SetInkingOff[8]={0x50,0x14,0x04,0x00,0xff,0xff,0xff,0x2c};		//设置轨迹关闭
uint8 code WakeUpEPH1660[8]={0x50,0x33,0x04,0x00,0x00,0x00,0x00,0xc7};
uint8 code TestCode[8]={0x55,0x55,0x55,0x55,0x55,0x55,0x55,0x55};
uint8 code SetEnaTapWake[8]={0x50,0x4A,0x04,0x01,0x02,0xFF,0xFF,0x96};	//无输入16S后进入省电模式
uint8 code SetNomalMode[8]={0x50,0x4A,0x04,0x01,0x00,0xFF,0xFF,0x40};	//不进入省电模
uint8 code ExitPowerSavingMode[8]={0x50,0x33,0x04,0xff,0xff,0xff,0xff,0x19};	//退出省电模式
uint8 code SetStrokeOverWaitingTime[8]={0x50,0x4D,0x04,0x20,0xFF,0xFF,0xFF,0x6C};//设置画笔等待时间
uint8 code SoftwareReset[8]={0x50,0x42,0x04,0xFF,0xFF,0xFF,0xFF,0xE3};	//软件复位
//----------------------------------------------------------------------------------------------

uint8   xdata  Rec_Data[8];//接收数据缓冲区


//CRC-8 8bits checksum table
uint8 code CRCTable[256]={
0x00,0x07,0x0E,0x09,0x1C,0x1B,0x12,0x15,0x38,0x3F,0x36,0x31,
0x24,0x23,0x2A,0x2D,0x70,0x77,0x7E,0x79,0x6C,0x6B,0x62,0x65,
0x48,0x4F,0x46,0x41,0x54,0x53,0x5A,0x5D,0xE0,0xE7,0xEE,0xE9,
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0xFA,0xFD,0xF4,0xF3};


/*---------------------------------------------------------------------------
函数原型: void Delayms(uint16 ms)
参数说明: ms--需要延时的值
返 回 值: 无
函数功能：延时程序(对于18.432M晶振单指令周期延时1mS)
----------------------------------------------------------------------------*/
void Delayms(uint16 ms)	  
{
   uint16 xdata i;
   for(;ms!=0;ms--)
		for(i=900;i!=0;i--);
}



void ResetEPH1660(void)
{
	EPH1660_CS=1;
	RESETB=0;
	Delayms(10);
	RESETB=1;
	Delayms(100);
	EPH1660_CS=0;
}


unsigned char GenerateCRC(uint8 * Packet,uint8 size)
{
	uint8 xdata i;
	uint8 xdata value;
	VerifyingFlag=1;
	value=0;
	for(i=0;i<size-1;i++){
	value ^= Packet[i];
	value = CRCTable[value];
	}
	VerifyingFlag=0;
	return value;
}


void MasterSPIInitiEPH1660(void)
{

   EPH1660_CS=1;		 
/*   MasterSPI_Send_Eph1660_Command(Recognition_Mode,8);
//   MasterSPI_Send_Eph1660_Command(SetInkingOff,8);

   while(MCUSndCmdFinishFlag==0);	//等待发送命令完成
   MCUSndCmdFinishFlag=0;
   WKICOM=1;
   Delayms(1000);*/
   
 //  MasterSPI_Send_Eph1660_Command(Set_Area,8);
 //MasterSPI_Send_Eph1660_Command(GraphicMode,8);
 //   MasterSPI_Send_Eph1660_Command(WakeUpEPH1660,8);
 //  MasterSPI_Send_Eph1660_Command(SetStrokeOverWaitingTime,8);
    MasterSPI_Send_Eph1660_Command(SoftwareReset,8);
   while(MCUSndCmdFinishFlag==0);	//等待发送命令完成
   MCUSndCmdFinishFlag=0;
   WKICOM=1;
   Delayms(1000);
   
}


void MasterSPI_Send_Eph1660_Command(uint8 *Databuf,uint8 l)
{
	MCUSndFlag=1;
	MCUSndDataLength=l;
	MCUSndDataPosition=0;
	MCUSndDataBuff=Databuf;
	MCUSndCmdFinishFlag=0;
	SPSTAT |= (SPIF|WCOL);	//清SPI中断标志
	SPDAT=*Databuf;		
	WKICOM=0;	//单片机开始发送命令
}

/**********************************************************
*函数名称			:DispManager	
*函数描述        	:按键管理线程
*输入参数   		:
*返回值				: 	
*全局变量			:byMainCmdQ
*调用模块  			:OSQPost
***********************************************************
*创建人	      		:尹运同
*创建日期	 		:2008-9-22
***********************************************************
*修改人	  			:
*修改日期    		:
*注释		      	:
**********************************************************/
void EPH1660Manager(void)
{ 	
/*	CCAPM0=0X00;	//禁止调度
    EPH1660MasterSPI();
	MasterSPIInitiEPH1660();
	CCAPM0=0X49;	//开启调度*/
	while(TRUE)
	{		
		WDT_CONTR = 0x3e;	//喂狗
		OSWait(K_TMO, 2);
	 	if(RecFramFinishFlag==1)
	 	{
	 		RecFramFinishFlag=0;
			if(Rec_Data[2]==0x04)	//一帧8个字节
			{
				if(Rec_Data[7]==GenerateCRC(Rec_Data,8))
					Send_Data(Rec_Data,8);
			}
			else if(Rec_Data[2]==0x02)	//一帧6个字节
		
			{
				if(Rec_Data[5]==GenerateCRC(Rec_Data,6))
					Send_Data(Rec_Data,6);
			}
			//Send_Data(Rec_Data,8);
	 	}		
		
	}	

}

